## config/west.yml
```yaml
manifest:
  remotes:
    - name: higo
      url-base: https://github.com/higo-p
  projects:
    - name: zmk
      remote: higo
      revision: main-keyball
      import: app/west.yml
  self:
    path: config
```
